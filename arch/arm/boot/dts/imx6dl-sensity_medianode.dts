/*
 * Definitions specific to the i.MX6DL version of the Medianode.
 *
 * Copyright (C) 2013 Sensity Systems, Inc.
 *
 * CONFIDENTIAL AND PROPRIETARY.
 */

/dts-v1/;

#include "imx6dl.dtsi"
#include "imx6qdl-sensity_medianode.dtsi"

/ {
	model = "Sensity Systems Medianode (MX6DL)";
	compatible = "sensity,medianode", "fsl,imx6dl";
};

&i2c4 {
	/*
	 * All signals go out on connectors J19 external sensor bus
	 * and J24 audio pod.
	 */
	clock-frequency = <400000>;
	pinctrl-names = "default";
	pinctrl-0 = <&pinctrl_i2c4_1>;	/*  "ENET TX" pins.  */
	status = "okay";
};

/*
 * Complete camboard_ch[01]_fixed_5v0 nodes.
 */
&camboard_ch0_fixed_5v0 {
	gpio = <&camboard_gpio 2 GPIO_ACTIVE_HIGH>;
	enable-active-high;
};
&camboard_ch1_fixed_5v0 {
	gpio = <&camboard_gpio 3 GPIO_ACTIVE_HIGH>;
	enable-active-high;
};
