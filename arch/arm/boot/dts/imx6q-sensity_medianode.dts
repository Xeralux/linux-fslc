/*
 * Definitions specific to the i.MX6D/Q version of the Medianode.
 *
 * Copyright (C) 2013 Sensity Systems, Inc.
 *
 * This program is free software; you can redistribute it and/or modify
 * it under the terms of the GNU General Public License version 2 as
 * published by the Free Software Foundation.
 */

/dts-v1/;

#include "imx6q.dtsi"
#include "imx6qdl-sensity_medianode.dtsi"

/ {
	model = "Sensity Systems Medianode (MX6D/Q)";
	compatible = "sensity,medianode", "fsl,imx6q";
};

&sata {
	status = "okay";
};


/*
 * Complete camboard_ch[01]_fixed_5v0 nodes.
 */
&camboard_ch0_fixed_5v0 {
	gpio = <&camboard_gpio 2 GPIO_ACTIVE_HIGH>;
	enable-active-high;
};
&camboard_ch1_fixed_5v0 {
	gpio = <&camboard_gpio 3 GPIO_ACTIVE_HIGH>;
	enable-active-high;
};
